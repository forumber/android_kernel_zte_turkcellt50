/* Copyright (c) 2012, Code Aurora Forum. All rights reserved.
 *
 * This program is free software; you can redistribute it and/or modify
 * it under the terms of the GNU General Public License version 2 and
 * only version 2 as published by the Free Software Foundation.
 *
 * This program is distributed in the hope that it will be useful,
 * but WITHOUT ANY WARRANTY; without even the implied warranty of
 * MERCHANTABILITY or FITNESS FOR A PARTICULAR PURPOSE.  See the
 * GNU General Public License for more details.
 */

/*---------------------------------------------------------------------------
 * This file is autogenerated file using gcdb parser. Please do not edit it.
 * Update input XML file to add a new entry or update variable in this file
 * VERSION = "1.0"
 *---------------------------------------------------------------------------*/
&mdss_mdp {

        dsi_otm1283a_tm_5p0_720p_video_700:qcom,mdss_dsi_otm1283a_tm_5p0_720p_video_700 {
              compatible = "qcom,mdss-dsi-panel";
              qcom,mdss-dsi-panel-name =  "zteTianma(otm1283a+TM)_720*1280_5.0Inch";
			  zte,lcd-proc-panel-name = "zteTianma(otm1283a+TM)_720*1280_5.0Inch";
              status = "disable";
		
              zte,lcd-product = <700>;
		qcom,mdss-pan-physical-height-dimension = <110>;
		qcom,mdss-pan-physical-width-dimension = <62>;
		qcom,cont-splash-enabled;
		qcom,mdss-dsi-panel-controller = <&mdss_dsi0>;
		qcom,mdss-dsi-panel-type = "dsi_video_mode";
		qcom,mdss-dsi-panel-destination = "display_1";
		qcom,mdss-dsi-panel-framerate = <60>;
		qcom,mdss-dsi-virtual-channel-id = <0>;
		qcom,mdss-dsi-stream = <0>;
		qcom,mdss-dsi-panel-width = <720>;
		qcom,mdss-dsi-panel-height = <1280>;
		qcom,mdss-dsi-h-front-porch = <70>;
		qcom,mdss-dsi-h-back-porch = <80>;
		qcom,mdss-dsi-h-pulse-width = <8>;
		qcom,mdss-dsi-h-sync-skew = <0>;
		qcom,mdss-dsi-v-back-porch = <20>;
		qcom,mdss-dsi-v-front-porch = <8>;
		qcom,mdss-dsi-v-pulse-width = <3>;
		qcom,mdss-dsi-h-left-border = <0>;
		qcom,mdss-dsi-h-right-border = <0>;
		qcom,mdss-dsi-v-top-border = <0>;
		qcom,mdss-dsi-v-bottom-border = <0>;
		qcom,mdss-dsi-bpp = <24>;
		qcom,mdss-dsi-color-order = "rgb_swap_rgb";
		qcom,mdss-dsi-underflow-color = <0xff>;
		qcom,mdss-dsi-border-color = <0>;
		
		qcom,mdss-dsi-h-sync-pulse = <1>;
		qcom,mdss-dsi-traffic-mode = "non_burst_sync_pulse";
		qcom,mdss-dsi-lane-map = "lane_map_0123";
		qcom,mdss-dsi-bllp-eof-power-mode;
		qcom,mdss-dsi-bllp-power-mode;
		qcom,mdss-dsi-lane-0-state;
		qcom,mdss-dsi-lane-1-state;
		qcom,mdss-dsi-lane-2-state;
		qcom,mdss-dsi-lane-3-state;
		qcom,mdss-dsi-panel-timings = [93 1E 14 00 44 48 18 22 19 03 04 00];
		qcom,mdss-dsi-t-clk-post = <0x0a>;
		qcom,mdss-dsi-t-clk-pre = <0x1d>;
		qcom,mdss-dsi-bl-min-level = <1>;
		qcom,mdss-dsi-bl-max-level = <255>;
		qcom,mdss-dsi-dma-trigger = <0x04>;
		qcom,mdss-dsi-mdp-trigger = <0x0>;
		qcom,mdss-dsi-bl-pmic-control-type = "bl_ctrl_dcs";
		qcom,mdss-dsi-reset-sequence = <1 10>, <0 20>, <1 10>;
 
    qcom,mdss-dsi-on-command = [	
     	29 01 00 00 00 00 02 00 00  		
		29 01 00 00 00 00 04 FF 12 83 01  		
		  
		29 01 00 00 00 00 02 00 80  		
		29 01 00 00 00 00 03 FF 12 83 
		  
		29 01 00 00 00 00 02 00 80 		
		29 01 00 00 00 00 0a C0 00     
		   64     
		   00   
		   0E    
		   12    
		   00     
		   64     
		   0E    
		   12  	 

		  
		29 01 00 00 00 00 02 00 B4  
		
		29 01 00 00 00 00 02 c0 55  
      
		29 01 00 00 00 00 02 00 a4  
		
		29 01 00 00 00 00 02 c0 00  
		
		29 01 00 00 00 00 02 00 87  
		
		29 01 00 00 00 00 02 c4 18 
		  
		29 01 00 00 00 00 02 00 80  
		
		29 01 00 00 00 00 02 C4 30  

		  
		29 01 00 00 00 00 02 00 8A   
		
		29 01 00 00 00 00 02 C4 40  

                  
		29 01 00 00 00 00 02 00 81  
		
		29 01 00 00 00 00 02 C1 66  
 
                  
		29 01 00 00 00 00 02 00 A0  
		
		29 01 00 00 00 00 02 C1 02  

                  
		29 01 00 00 00 00 02 00 81  
		
		29 01 00 00 00 00 02 C4 82  
		
		//esd code by lxt
		29 01 00 00 00 00 02 00 80  
		
		29 01 00 00 00 00 02 C4 01  
		
		29 01 00 00 00 00 02 00 88  
		
		29 01 00 00 00 00 02 C4 80  
		
		29 01 00 00 00 00 02 00 C2  
		
		29 01 00 00 00 00 02 F5 C0  		
		//esd end
/////
		  
		29 01 00 00 00 00 02 00 90  
		
		29 01 00 00 00 00 02 C4 52//49  


		  
		29 01 00 00 00 00 02 00 82   
		
		29 01 00 00 00 00 02 C4 02  


		  
		29 01 00 00 00 00 02 00 C6   
		
		29 01 00 00 00 00 02 B0  03  


		  
		29 01 00 00 00 00 02 00 A0   
		
		29 01 00 00 00 00 0f C4 05   
		   10    
		   06    
		   02    
		   05    
		   15    
		   10    
		   05    
		   10    
		   07    
		   02    
		   05    
		   15    
		   10    
		  
       
		    		
		29 01 00 00 00 00 02 00 B0   
		
		29 01 00 00 00 00 03 C4 00 00  

		    		
		29 01 00 00 00 00 02 00 BB   
		
		29 01 00 00 00 00 02 C5 80  

		    		
		29 01 00 00 00 00 02 00 91   
		
		29 01 00 00 00 00 03 C5 16 50  

		    		
		29 01 00 00 00 00 02 00 00   
		
		29 01 00 00 00 00 03 D8 9D 9D  

		    		
		29 01 00 00 00 00 02 00 B0  
		
		29 01 00 00 00 00 03 C5 04 B8  

		  
		29 01 00 00 00 00 02 00 90   
		
		29 01 00 00 00 00 05 F5 02 11 02 11  

		    		
		29 01 00 00 00 00 02 00 90   
		
		29 01 00 00 00 00 02 C5 50  

		    		
		29 01 00 00 00 00 02 00 94  
		
		29 01 00 00 00 00 02 C5 66  

		    		
		29 01 00 00 00 00 02 00 B2  
		
		29 01 00 00 00 00 03 F5 00 00  

		    		
		29 01 00 00 00 00 02 00 B4   
		
		29 01 00 00 00 00 03 F5 00 00  

		    		
		29 01 00 00 00 00 02 00 B6   
		
		29 01 00 00 00 00 03 F5 00 00  

		    		
		29 01 00 00 00 00 02 00 B8   
		
		29 01 00 00 00 00 03 F5 00 00  

		    		
		29 01 00 00 00 00 02 00 94   
		
		29 01 00 00 00 00 02 F5  02  

		    		
		29 01 00 00 00 00 02 00 BA   
		
		29 01 00 00 00 00 02 F5 03  

		    		
		29 01 00 00 00 00 02 00 B4   
		
		29 01 00 00 00 00 02 C5 C0  

		    		
	//	29 01 00 00 00 00 02 00 80   
		
	//	29 01 00 00 00 00 02 C4 00  

		  
		29 01 00 00 00 00 02 00 80   
		
		29 01 00 00 00 00 0c CB  00  
		   00  
		   00  
		   00  
		   00  
		   00  
		   00  
		   00  
		   00  
		   00  
		   00  

		  
		29 01 00 00 00 00 02 00 90   
		29 01 00 00 00 00 10 CB 00  
		   00  
		   00  
		   00  
		   00  
		   00  
		   00  
		   00  
		   00  
		   00  
		   00  		
		   00  
		   00  
		   00  
		   00  		

		  
		29 01 00 00 00 00 02 00 A0   
		29 01 00 00 00 00 10 CB  00  
		   00  
		   00  
		   00  
		   00  
		   00  
		   00  
		   00  
		   00  
		   00  
		   00  		
		   00  
		   00  
		   00  
		   00  

		  
		29 01 00 00 00 00 02 00 B0   
		29 01 00 00 00 00 10 CB  00  
		   00  
		   00  
		   00  
		   00  
		   00  
		   00  
		   00  
		   00  
		   00  
		   00  		
		   00  
		   00  
		   00  
		   00  

		  
		29 01 00 00 00 00 02 00 C0   
		29 01 00 00 00 00 10 CB 05  
		   05  
		   05  
		   05  
		   05  
		   05  
		   00  
		   00  
		   00  
		   00  
		   00  		
		   00  
		   00  
		   00  
		   00  

		  
		29 01 00 00 00 00 02 00 D0  
		29 01 00 00 00 00 10 CB 00  
		   00  
		   00  
		   00  
		   05  
		   05  
		   05  
		   05  
		   05  
		   05  
		   05  		
		   05  
		   05  
		   00  
		   00  

		 //
		29 01 00 00 00 00 02 00 E0  
		29 01 00 00 00 00 0f CB 00  
		   00  
		   00  
		   00  
		   00  
		   00  
		   00  
		   00  
		   00  
		   00  
		   00  		
		   05  
		   05  
		   05  

		  
		29 01 00 00 00 00 02 00 F0   
		29 01 00 00 00 00 0c CB FF  
		   CF  
		   00  
		   03  
		   C0  
		   F0  
		   FF  
		   0C  
		   30  
		   00  
		   0C  		

		  
		29 01 00 00 00 00 02 00 80   
		29 01 00 00 00 00 10 CC 0C  
		   0A  
		   10  
		   0E  
		   02  
		   04  
		   00  
		   00  
		   00  
		   00  
		   00  		
		   00  
		   00  
		   00  
		   00  

		  
		29 01 00 00 00 00 02 00 90   
		29 01 00 00 00 00 10 CC 00  
		   00  
		   00  
		   00  
		   06  
		   2D  
		   2E  
		   0B  
		   09  
		   0F  
		   0D  		
		   01  
		   03  
		   00  
		   00  

		  
		29 01 00 00 00 00 02 00 A0  
		29 01 00 00 00 00 0f CC 00  
		   00  
		   00  
		   00  
		   00  
		   00  
		   00  
		   00  
		   00  
		   00  
		   00  		
		   05  
		   2D  
		   2E  

		  
		29 01 00 00 00 00 02 00 B0   
		29 01 00 00 00 00 10 CC 0D  
		   0F  
		   09  
		   0B  
		   03  
		   01  
		   00  
		   00  
		   00  
		   00  
		   00  		
		   00  
		   00  
		   00  
		   00  

		  
		29 01 00 00 00 00 02 00 C0   
		29 01 00 00 00 00 10 CC 00  
		   00  
		   00  
		   00  
		   05  
		   2E  
		   2D  
		   0E  
		   10  
		   0A  
		   0C  
		   04  
		   02  
		   00  
		   00  		

		  
		29 01 00 00 00 00 02 00 D0   
		29 01 00 00 00 00 0f CC 00  
		   00  
		   00  
		   00  
		   00  
		   00  
		   00  
		   00  
		   00  
		   00  
		   00  		
		   06  
		   2E  
		   2D  

		  
		29 01 00 00 00 00 02 00 80   
		29 01 00 00 00 00 0d CE 8B  
		   03  
		   18  
		   8A  
		   03  
		   18  
		   89  
		   03  
		   18  
		   88  
		   03  		
		   18  

		  
		29 01 00 00 00 00 02 00 90   
		29 01 00 00 00 00 0f CE 38  
		   10  
		   18  
		   38  
		   0F  
		   18  
		   00  
		   00  
		   00  
		   00  
		   00  		
		   00  
		   00  		
		   00  

		  
		29 01 00 00 00 00 02 00 A0   
		29 01 00 00 00 00 0f CE 38  
		   07  
		   05  
		   00  
		   00  
		   18  
		   00  
		   38  
		   06  
		   05  
		   01  		
		   00  
		   18  		
		   00  

		  
		29 01 00 00 00 00 02 00 B0   
		29 01 00 00 00 00 0f CE 38  
		   05  
		   05  
		   02  
		   00  
		   18  
		   00  
		   38  
		   04  
		   05  
		   03  		
		   00  
		   18  		
		   00  

		  
		29 01 00 00 00 00 02 00 C0  
		29 01 00 00 00 00 0f CE 38  
		   03  
		   05  
		   04  
		   00  
		   18  
		   00  
		   38  
		   02  
		   05  
		   05  		
		   00  
		   18  		
		   00  

		   ///
		29 01 00 00 00 00 02 00 D0   
		29 01 00 00 00 00 0f CE 38  
		   01  
		   05  
		   06  
		   00  
		   18  
		   00  
		   38  
		   00  
		   05  
		   07  		
		   00  
		   18  		
		   00  

		  
		29 01 00 00 00 00 02 00 80   
		29 01 00 00 00 00 0f CF 00  
		   00  
		   00  
		   00  
		   00  
		   00  
		   00  
		   00  
		   00  
		   00  
		   00  		
		   00  
		   00  
		   00  

		  
		29 01 00 00 00 00 02 00 90   
		29 01 00 00 00 00 0f CF 00  
		   00  
		   00  
		   00  
		   00  
		   00  
		   00  
		   00  
		   00  
		   00  
		   00  		
		   00  
		   00  
		   00  

		  
		29 01 00 00 00 00 02 00 A0   
		29 01 00 00 00 00 0f CF 00  
		   00  
		   00  
		   00  
		   00  
		   00  
		   00  
		   00  
		   00  
		   00  
		   00  		
		   00  
		   00  
		   00  

		  
		29 01 00 00 00 00 02 00 B0   
		29 01 00 00 00 00 0f CF 00  
		   00  
		   00  
		   00  
		   00  
		   00  
		   00  
		   00  
		   00  
		   00  
		   00  		
		   00  
		   00  
		   00  

		  
		29 01 00 00 00 00 02 00 C0   
		29 01 00 00 00 00 0c CF 01  
		   01  
		   20  
		   20  
		   00  
		   00  
		   01  
		   01  //
		   00  
		   00  //
		   08  		

		 
		29 01 00 00 00 00 02 00 B5   
		29 01 00 00 00 00 07 C5 38  
		   20  
		   BF  
		   38  
		   20  
		   BF  
		  
		29 01 00 00 00 00 02 00 00   
		29 01 00 00 00 00 11 E1 05  
		   0c  
		   11  
		   0D  
		   06  
		   10  
		   0b  
		   0A  
		   03  
		   07  
		   0b  		
		   07  
		   0E  
		   13  
		   0e  
		   02  

		  
		29 01 00 00 00 00 02 00 00   
		29 01 00 00 00 00 11 E2 05  
		   0c  
		   11  
		   0D  
		   06  
		   10  
		   0b  
		   0A  
		   03  
		   07  
		   0b  		
		   07  
		   0E  
		   13  
		   0e  
		   02  

		      		
		29 01 00 00 00 00 02 00 92   
		29 01 00 00 00 00 03 FF 30 02  	
		      		
		//29 01 00 00 00 00 02 00 00   
		//29 01 00 00 00 00 02 D9 72 //for otp
		
		39 01 00 00 00 00 02 35 00 	

	    39 01 00 00 00 00 02 51  00 
		39 01 00 00 00 00 02 53  24 
		39 01 00 00 00 00 02 55  01 			
	
		05 01 00 00 96 00 02 11 00 
        05 01 00 00 32 00 02 29 00 
		];
		qcom,mdss-dsi-on-command-state = "dsi_lp_mode";
		qcom,mdss-dsi-off-command = [05 01 00 00 32 00 02 28 00
					                 05 01 00 00 78 00 02 10 00];
                qcom,mdss-dsi-off-command-state = "dsi_hs_mode";
        };
};