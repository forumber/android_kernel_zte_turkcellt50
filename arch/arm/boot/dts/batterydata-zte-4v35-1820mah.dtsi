/* Copyright (c) 2013, The Linux Foundation. All rights reserved.
 *
 * This program is free software; you can redistribute it and/or modify
 * it under the terms of the GNU General Public License version 2 and
 * only version 2 as published by the Free Software Foundation.
 *
 * This program is distributed in the hope that it will be useful,
 * but WITHOUT ANY WARRANTY; without even the implied warranty of
 * MERCHANTABILITY or FITNESS FOR A PARTICULAR PURPOSE.  See the
 * GNU General Public License for more details.
 */

qcom,zte-4v35-1820mAh-data {
	qcom,fcc-mah = <1820>;
	qcom,default-rbatt-mohm = <170>;
	qcom,rbatt-capacitive-mohm = <0>;
	qcom,flat-ocv-threshold-uv = <3800000>;
	qcom,max-voltage-uv = <4350000>;
	qcom,v-cutoff-uv = <3400000>;
	qcom,chg-term-ua = <100000>;
	qcom,batt-id-kohm = <210>;

	qcom,rbatt-sf-lut {
		qcom,lut-col-legend = <(-20) 0 25 40 60>;
		qcom,lut-row-legend = <100 95 90 85 80>,
				<75 70 65 60 55>,
				<50 45 40 35 30>,
				<25 20 16 13 11>,
				<10 9 8 7 6>,
				<5 4 3 2 1>;
		qcom,lut-data = <1220 300 100 72 62>,
				<1217 310 104 75 63>,
				<1217 310 104 75 63>,
				<1203 318 109 78 66>,
				<1183 323 113 81 68>,
				<1171 325 119 85 70>,
				<1171 322 124 88 73>,
				<1177 329 127 93 76>,
				<1186 334 111 86 74>,
				<1202 343 105 75 64>,
				<1234 355 107 77 65>,
				<1313 371 113 80 68>,
				<1423 392 118 82 72>,
				<1554 419 123 86 74>,
				<1712 448 130 86 67>,
				<1911 482 134 85 67>,
				<2175 526 135 86 67>,
				<2439 572 131 83 65>,
				<2682 609 137 85 67>,
				<2838 628 146 90 70>,
				<2850 622 151 93 72>,
				<2729 608 153 94 72>,
				<2952 628 157 95 72>,
				<3246 656 160 95 71>,
				<3606 683 160 92 70>,
				<4100 714 161 93 71>,
				<4831 752 169 97 75>,
				<5860 795 182 104 80>,
				<7750 950 207 116 84>,
				<12409 1786 252 136 99>;
	};

	qcom,fcc-temp-lut {
		qcom,lut-col-legend = <(-20) 0 25 40 60>;
		qcom,lut-data = <1804 1807 1804 1803 1799>;
	};

	qcom,pc-temp-ocv-lut {
		qcom,lut-col-legend = <(-20) 0 25 40 60>;
		qcom,lut-row-legend = <100 95 90 85 80>,
				<75 70 65 60 55>,
				<50 45 40 35 30>,
				<25 20 16 13 11>,
				<10 9 8 7 6>,
				<5 4 3 2 1>,
				<0>;
		qcom,lut-data = <4325 4321 4316 4311 4305>,
				<4239 4247 4249 4248 4245>,
				<4167 4186 4192 4192 4189>,
				<4104 4130 4138 4138 4136>,
				<4037 4077 4087 4086 4085>,
				<3979 4019 4038 4039 4036>,
				<3934 3964 3991 3993 3993>,
				<3895 3922 3952 3954 3952>,
				<3861 3883 3898 3906 3907>,
				<3833 3850 3858 3860 3861>,
				<3809 3822 3831 3832 3833>,
				<3788 3799 3809 3810 3811>,
				<3769 3781 3792 3791 3792>,
				<3751 3767 3777 3776 3776>,
				<3734 3753 3767 3762 3751>,
				<3716 3739 3753 3745 3731>,
				<3696 3723 3727 3720 3707>,
				<3674 3709 3696 3688 3675>,
				<3654 3696 3684 3676 3665>,
				<3638 3686 3680 3673 3662>,
				<3629 3682 3678 3672 3661>,
				<3621 3676 3676 3670 3659>,
				<3608 3669 3673 3667 3655>,
				<3593 3657 3665 3658 3643>,
				<3574 3637 3643 3634 3616>,
				<3548 3604 3605 3594 3575>,
				<3511 3556 3553 3543 3525>,
				<3458 3489 3487 3480 3463>,
				<3378 3394 3404 3398 3377>,
				<3243 3260 3281 3271 3245>,
				<3000 3000 3000 3000 3000>;
	};
};
