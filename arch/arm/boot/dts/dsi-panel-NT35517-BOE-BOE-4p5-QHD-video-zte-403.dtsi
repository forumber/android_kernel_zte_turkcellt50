/* Copyright (c) 2012, Code Aurora Forum. All rights reserved.
 *
 * This program is free software; you can redistribute it and/or modify
 * it under the terms of the GNU General Public License version 2 and
 * only version 2 as published by the Free Software Foundation.
 *
 * This program is distributed in the hope that it will be useful,
 * but WITHOUT ANY WARRANTY; without even the implied warranty of
 * MERCHANTABILITY or FITNESS FOR A PARTICULAR PURPOSE.  See the
 * GNU General Public License for more details.
 */

/*---------------------------------------------------------------------------
 * This file is autogenerated file using gcdb parser. Please do not edit it.
 * Update input XML file to add a new entry or update variable in this file
 * VERSION = "1.0"
 *---------------------------------------------------------------------------*/
&mdss_mdp {

		dsi_nt35517_BOE_qhd_vid: qcom,mdss_dsi_NT35517_BOE_4p5_qhd_video_403 {
		
		qcom,mdss-dsi-panel-name = "nt35517 BOE 4p5 qhd video mode dsi panel-kernel";		
		zte,lcd-proc-panel-name = "zteBOE(nt35517+BOE)_540*960_4.5Inch";
		zte,lcd-product = <403>;	
        qcom,cont-splash-enabled;		
		qcom,mdss-dsi-panel-controller = <&mdss_dsi0>;
		qcom,mdss-dsi-panel-type = "dsi_video_mode";
		qcom,mdss-dsi-panel-destination = "display_1";
		qcom,mdss-dsi-panel-framerate = <60>;
		qcom,mdss-dsi-virtual-channel-id = <0>;
		qcom,mdss-dsi-stream = <0>;
		qcom,mdss-dsi-panel-width = <540>;
		qcom,mdss-dsi-panel-height = <960>;
		qcom,mdss-dsi-h-front-porch = <80>;//60
		qcom,mdss-dsi-h-back-porch = <80>;
		qcom,mdss-dsi-h-pulse-width = <8>;
		qcom,mdss-dsi-h-sync-skew = <0>;
		qcom,mdss-dsi-v-back-porch = <20>;//15
		qcom,mdss-dsi-v-front-porch = <20>;//7
		qcom,mdss-dsi-v-pulse-width = <10>;//5
		qcom,mdss-dsi-h-left-border = <0>;
		qcom,mdss-dsi-h-right-border = <0>;
		qcom,mdss-dsi-v-top-border = <0>;
		qcom,mdss-dsi-v-bottom-border = <0>;
		qcom,mdss-dsi-bpp = <24>;
		qcom,mdss-dsi-color-order = "rgb_swap_rgb";
		qcom,mdss-dsi-underflow-color = <0xff>;
		qcom,mdss-dsi-border-color = <0>;		
		qcom,mdss-dsi-h-sync-pulse = <1>;
		qcom,mdss-dsi-traffic-mode = "non_burst_sync_pulse";
		qcom,mdss-dsi-lane-map = "lane_map_3012";
		qcom,mdss-dsi-bllp-eof-power-mode;
		qcom,mdss-dsi-bllp-power-mode;
		qcom,mdss-dsi-lane-0-state;
		qcom,mdss-dsi-lane-1-state;
		qcom,mdss-dsi-panel-timings = [76 1A 10 00 3C 42 14 1C 15 03 04 00];
		//qcom,mdss-dsi-panel-clock-rate = <450000000>;  //add  Andy
                qcom,mdss-dsi-t-clk-post = <0x22>;
		qcom,mdss-dsi-t-clk-pre = <0x3d>;
		qcom,mdss-dsi-bl-min-level = <1>;
		qcom,mdss-dsi-bl-max-level = <3100>; //<4095>;			
		qcom,mdss-dsi-dma-trigger = <0x04>;
		qcom,mdss-dsi-mdp-trigger = <0x0>;
		qcom,mdss-dsi-bl-pmic-control-type = "bl_ctrl_wled";
		qcom,mdss-dsi-bl-cmd-gpio = <&msmgpio 34 0>;
		qcom,mdss-dsi-on-command = [		
                     39 01 00 00 00 00 06	    
F0 55 AA 52 08 00	 

39 01 00 00 00 00 06	    
B0 00 0C 40	3C 3C	 

39 01 00 00 00 00 03	    
B1 FC 00	    

39 01 00 00 00 00 02    
B6 08	    

39 01 00 00 00 00 03	    
B7 03 04
	    
	
39 01 00 00 00 00 02    
BA 01	    

39 01 00 00 00 00 02    
BC 00	    

39 01 00 00 00 00 06	    
BD 01 54 06	10	01	 

39 01 00 00 00 00 04	    
CC 03 00 00	    

39 01 00 00 00 00 05	    
B8 01 02 02	02	    

39 01 00 00 00 00 03	    
BB 52 50	    	    


39 01 00 00 00 00 06	    
F0 55 AA 52	08 01	 

39 01 00 00 00 00 04	    
B0 0A 0A 0A	    

39 01 00 00 00 00 04	    
B6 33 33 33	    

39 01 00 00 00 00 04	    
B1 0A 0A 0A	    


39 01 00 00 00 00 04	    
B7 24 24 24	    

39 01 00 00 00 00 04	    
B2 03 03 03	    

39 01 00 00 00 00 04	    
B8  33  33	33	    

39 01 00 00 00 00 04	    
B3  0C	0C	0C	    

39 01 00 00 00 00 04	    
B9 25 25 25	    

39 01 00 00 00 00 04	    
B4 0A 0A 0A	    

39 01 00 00 00 00 04	    
BA   
25	    
25	    
25	    

39 01 00 00 00 00 04	    
B5   
07	    
07	    
07	    

39 01 00 00 00 00 04	    
BC   
00	    
90	    
06	    

39 01 00 00 00 00 04	    
BD   
00	    
90	    
06	    

39 01 00 00 00 00 02	    
BE   
56	    

39 01 00 00 00 00 02	    
BF   
3F	    

39 01 00 00 00 00 11	   
D1   
00	  
43	  
00	  
51	  
00	  
6C	  
00	  
83	  
00	  
95	  
00	  
B5	  
00	  
D2	  
01	 
03	  

39 01 00 00 00 00 11
D2 
01	  
2C	  
01	  
6E	  
01	  
A4	  
01	  
FB	  
02	  
44	  
02	  
46	  
02	  
87	  
02	  
CC	  

39 01 00 00 00 00 11
D3  
02	  
F3	  
03	  
29	  
03	  
4D	  
03	  
78	  
03	  
96	  
03	  
BA	  
03	  
DE	  
03	  
F4

39 01 00 00 00 00 05
D4  
03	  
FE	  
03	  
FF	  

39 01 00 00 00 00 11
D5  
00	  
43	  
00	  
51	  
00	  
6C	  
00	  
83	  
00	  
95	  
00	  
B5	  
00	  
D2
01	  
03

39 01 00 00 00 00 11
D6  
01	  
2C	  
01	  
6E	  
01	  
A4	  
01	  
FB	  
02	  
44	  
02	  
46	  
02	  
87	  
02	  
CC	  

39 01 00 00 00 00 11
D7  
02	  
F3	  
03	  
29	  
03	  
4D	  
03	  
78	  
03	  
96	  
03	  
BA	  
03	  
DE	  
03	  
F4

39 01 00 00 00 00 05
D8  
03	  
FE	  
03	  
FF	  

39 01 00 00 00 00 11
D9  
00	  
43	  
00	  
51	  
00	  
6C	  
00	  
83	  
00	  
95	  
00	  
B5	  
00	  
D2
01	  
03

39 01 00 00 00 00 11
DD  
01	  
2C	  
01	  
6E	  
01	  
A4	  
01	  
FB	  
02	  
44	  
02	  
46	  
02	  
87	  
02	  
CC	  

39 01 00 00 00 00 11
DE  
02	  
F3	  
03	  
29	  
03	  
4D	  
03	  
78	  
03	  
96	  
03	  
BA	  
03	  
DE	  
03	  
F4

39 01 00 00 00 00 05
DF  
03	  
FE	  
03	  
FF	  

39 01 00 00 00 00 11
E0  
00	  
43	  
00	  
51	  
00	  
6C	  
00	  
83	  
00	  
95	  
00	  
B5	  
00	  
D2
01	  
03

39 01 00 00 00 00 11
E1  
01	  
2C	  
01	  
6E	  
01	  
A4	  
01	  
FB	  
02	  
44	  
02	  
46	  
02	  
87	  
02	  
CC	  

39 01 00 00 00 00 11
E2  
02	  
F3	  
03	  
29	  
03	  
4D	  
03	  
78	  
03	  
96	  
03	  
BA	  
03	  
DE	  
03	  
F4

39 01 00 00 00 00 05
E3  
03	  
FE	  
03	  
FF	  

39 01 00 00 00 00 11
E4  
00	  
43	  
00	  
51	  
00	  
6C	  
00	  
83	  
00	  
95	  
00	  
B5	  
00	  
D2
01	  
03

39 01 00 00 00 00 11
E5  
01	  
2C	  
01	  
6E	  
01	  
A4	  
01	  
FB	  
02	  
44	  
02	  
46	  
02	  
87	  
02	  
CC	  

39 01 00 00 00 00 11
E6  
02	  
F3	  
03	  
29	  
03	  
4D	  
03	  
78	  
03	  
96	  
03	  
BA	  
03	  
DE	  
03	  
F4

39 01 00 00 00 00 05
E7  
03	  
FE	  
03	  
FF	  

39 01 00 00 00 00 11
E8  
00	  
43	  
00	  
51	  
00	  
6C	  
00	  
83	  
00	  
95	  
00	  
B5	  
00	  
D2
01	  
03

39 01 00 00 00 00 11
E9  
01	  
2C	  
01	  
6E	  
01	  
A4	  
01	  
FB	  
02	  
44	  
02	  
46	  
02	  
87	  
02	  
CC	  

39 01 00 00 00 00 11
EA  
02	  
F3	  
03	  
29	  
03	  
4D	  
03	  
78	  
03	  
96	  
03	  
BA	  
03	  
DE	  
03	  
F4

39 01 00 00 00 00 05
EB  
03	  
FE	  
03	  
FF	  

39 01 00 00 00 00 02
35  
00	  

39 01 00 00 00 00 02
51  
FF	  

39 01 00 00 00 00 02
53  
2C	  

39 01 00 00 00 00 02
55  
02	  			   
                        05 01 00 00 96 00 02 
                                11 00 
                        05 01 00 00 78 00 02 
                                29 00 
				];
		qcom,mdss-dsi-on-command-state = "dsi_lp_mode";
		qcom,mdss-dsi-off-command = [05 01 00 00 32 00 02 28 00
					05 01 00 00 78 00 02 10 00];
		qcom,mdss-dsi-off-command-state = "dsi_hs_mode";
	};
};
