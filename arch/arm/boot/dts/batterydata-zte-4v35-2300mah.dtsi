/* Copyright (c) 2013, The Linux Foundation. All rights reserved.
 *
 * This program is free software; you can redistribute it and/or modify
 * it under the terms of the GNU General Public License version 2 and
 * only version 2 as published by the Free Software Foundation.
 *
 * This program is distributed in the hope that it will be useful,
 * but WITHOUT ANY WARRANTY; without even the implied warranty of
 * MERCHANTABILITY or FITNESS FOR A PARTICULAR PURPOSE.  See the
 * GNU General Public License for more details.
 */

qcom,zte-4v35-2300mAh-data {
	qcom,fcc-mah = <2300>;
	qcom,default-rbatt-mohm = <172>;
	qcom,rbatt-capacitive-mohm = <0>;
	qcom,flat-ocv-threshold-uv = <3800000>;
	qcom,max-voltage-uv = <4350000>;
	qcom,v-cutoff-uv = <3400000>;
	qcom,chg-term-ua = <100000>;
	qcom,batt-id-kohm = <110>;

	qcom,rbatt-sf-lut {
		qcom,lut-col-legend = <(-20) 0 25 40 60>;
		qcom,lut-row-legend = <100 95 90 85 80>,
				<75 70 65 60 55>,
				<50 45 40 35 30>,
				<25 20 16 13 11>,
				<10 9 8 7 6>,
				<5 4 3 2 1>;
		qcom,lut-data = <1105 239 100 84 80>,
				<1103 239 100 84 80>,
				<1053 247 103 87 82>,
				<999 252 107 89 83>,
				<980 251 112 92 84>,
				<900 258 119 96 86>,
				<881 234 122 98 88>,
				<880 232 131 103 92>,
				<880 235 126 107 94>,
				<896 233 106 98 90>,
				<928 233 102 87 82>,
				<966 235 102 89 84>,
				<1011 237 105 92 87>,
				<1061 241 108 94 89>,
				<1116 249 111 93 87>,
				<1181 255 111 91 83>,
				<1246 257 108 90 84>,
				<1278 267 106 89 83>,
				<1142 262 99 85 80>,
				<1146 266 100 88 83>,
				<1170 272 102 89 84>,
				<1194 279 106 91 86>,
				<1224 288 108 93 88>,
				<1254 297 112 96 92>,
				<1291 303 117 98 93>,
				<1336 304 114 94 87>,
				<1466 306 108 92 86>,
				<1745 315 111 94 89>,
				<2967 335 120 101 96>,
				<18685 1476 474 293 270>;
	};

	qcom,fcc-temp-lut {
		qcom,lut-col-legend = <(-20) 0 25 40 60>;
		qcom,lut-data = <2372 2375 2382 2381 2369>;
	};

	qcom,pc-temp-ocv-lut {
		qcom,lut-col-legend = <(-20) 0 25 40 60>;
		qcom,lut-row-legend = <100 95 90 85 80>,
				<75 70 65 60 55>,
				<50 45 40 35 30>,
				<25 20 16 13 11>,
				<10 9 8 7 6>,
				<5 4 3 2 1>,
				<0>;
		qcom,lut-data = <4323 4323 4319 4313 4305>,
				<4223 4250 4251 4249 4244>,
				<4156 4196 4197 4195 4190>,
				<4095 4144 4146 4143 4139>,
				<4052 4092 4097 4093 4089>,
				<3966 4045 4055 4047 4042>,
				<3915 3964 3993 3997 4000>,
				<3877 3923 3961 3964 3961>,
				<3842 3896 3921 3925 3923>,
				<3816 3865 3872 3879 3877>,
				<3798 3838 3841 3842 3841>,
				<3783 3814 3819 3819 3819>,
				<3768 3793 3800 3801 3800>,
				<3754 3776 3785 3785 3784>,
				<3740 3763 3773 3769 3764>,
				<3724 3747 3760 3753 3741>,
				<3707 3727 3741 3733 3719>,
				<3690 3713 3714 3707 3693>,
				<3672 3706 3691 3683 3671>,
				<3657 3700 3688 3681 3669>,
				<3648 3697 3688 3680 3668>,
				<3636 3694 3687 3679 3668>,
				<3623 3691 3686 3678 3666>,
				<3607 3685 3684 3676 3664>,
				<3587 3674 3678 3671 3657>,
				<3561 3651 3658 3649 3629>,
				<3525 3613 3612 3602 3581>,
				<3472 3557 3546 3537 3517>,
				<3387 3474 3453 3447 3426>,
				<3272 3342 3305 3301 3280>,
				<3000 3000 3000 3000 3000>;
	};
};
