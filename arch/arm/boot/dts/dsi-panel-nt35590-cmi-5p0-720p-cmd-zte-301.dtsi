/* Copyright (c) 2012, Code Aurora Forum. All rights reserved.
 *
 * This program is free software; you can redistribute it and/or modify
 * it under the terms of the GNU General Public License version 2 and
 * only version 2 as published by the Free Software Foundation.
 *
 * This program is distributed in the hope that it will be useful,
 * but WITHOUT ANY WARRANTY; without even the implied warranty of
 * MERCHANTABILITY or FITNESS FOR A PARTICULAR PURPOSE.  See the
 * GNU General Public License for more details.
 */

/*---------------------------------------------------------------------------
 * This file is autogenerated file using gcdb parser. Please do not edit it.
 * Update input XML file to add a new entry or update variable in this file
 * VERSION = "1.0"
 *---------------------------------------------------------------------------*/
&mdss_mdp {

        dsi_nt35590_cmi_5p0_720p_cmd_301:qcom,mdss_dsi_nt35590_cmi_5p0_720p_cmd_301 {
		qcom,mdss-dsi-panel-name =  "zteTRULY(NT35590B_CMI)_720*1280_5.0Inch";
		zte,lcd-proc-panel-name  =  "zteTRULY(NT35590B_CMI)_720*1280_5.0Inch";
		zte,lcd-product = <301>;
		qcom,mdss-pan-physical-height-dimension = <110>;
		qcom,mdss-pan-physical-width-dimension = <62>;
		qcom,cont-splash-enabled;
		qcom,mdss-dsi-panel-controller = <&mdss_dsi0>;
		qcom,mdss-dsi-panel-type = "dsi_cmd_mode";
		qcom,mdss-dsi-panel-destination = "display_1";
		qcom,mdss-dsi-panel-framerate = <57>;
		qcom,mdss-dsi-virtual-channel-id = <0>;
		qcom,mdss-dsi-stream = <0>;
		qcom,mdss-dsi-panel-width = <720>;
		qcom,mdss-dsi-panel-height = <1280>;
		qcom,mdss-dsi-h-front-porch = <140>;
		qcom,mdss-dsi-h-back-porch = <164>;
		qcom,mdss-dsi-h-pulse-width = <8>;
		qcom,mdss-dsi-h-sync-skew = <0>;
		qcom,mdss-dsi-v-back-porch = <11>;
		qcom,mdss-dsi-v-front-porch = <8>;
		qcom,mdss-dsi-v-pulse-width = <3>;
		qcom,mdss-dsi-h-left-border = <0>;
		qcom,mdss-dsi-h-right-border = <0>;
		qcom,mdss-dsi-v-top-border = <0>;
		qcom,mdss-dsi-v-bottom-border = <0>;
		qcom,mdss-dsi-bpp = <24>;
		qcom,mdss-dsi-color-order = "rgb_swap_rgb";
		qcom,mdss-dsi-underflow-color = <0xff>;
		qcom,mdss-dsi-border-color = <0>;
		
		qcom,mdss-dsi-h-sync-pulse = <1>;
		qcom,mdss-dsi-traffic-mode = "burst_mode";
		qcom,mdss-dsi-lane-map = "lane_map_0123";
		qcom,mdss-dsi-bllp-eof-power-mode;
		qcom,mdss-dsi-bllp-power-mode;
		qcom,mdss-dsi-lane-0-state;
		qcom,mdss-dsi-lane-1-state;
		qcom,mdss-dsi-lane-2-state;
		qcom,mdss-dsi-lane-3-state;
		qcom,mdss-dsi-te-pin-select = <1>;
		qcom,mdss-dsi-te-v-sync-rd-ptr-irq-line = <0x2c>;
		qcom,mdss-dsi-te-dcs-command = <1>;
		qcom,mdss-dsi-te-check-enable;
		qcom,mdss-dsi-te-using-te-pin;
		qcom,mdss-dsi-panel-timings = [93 1E 14 00 44 48 18 22 19 03 04 00];
		qcom,mdss-dsi-t-clk-post = <0x0a>;
		qcom,mdss-dsi-t-clk-pre = <0x1d>;
		qcom,mdss-dsi-bl-min-level = <1>;
		qcom,mdss-dsi-bl-max-level = <255>;
		qcom,mdss-dsi-dma-trigger = <0x04>;
		qcom,mdss-dsi-mdp-trigger = <0x0>;
		qcom,mdss-dsi-bl-pmic-control-type = "bl_ctrl_dcs";
		qcom,mdss-dsi-reset-sequence = <1 10>, <0 20>, <1 10>;

    qcom,mdss-dsi-on-command = [
     39 01 00 00 00 00 02 FF 00
     39 01 00 00 00 00 02 BA 03
     39 01 00 00 00 00 02 C2 08
     39 01 00 00 00 00 02 55 b0
     39 01 00 00 00 00 06 3b 03 07 04 3c 3c
     39 01 00 00 00 00 02 FF 01
     39 01 00 00 00 00 02 00 3A
     39 01 00 00 00 00 02 01 33
     39 01 00 00 00 00 02 02 53
     39 01 00 00 00 00 02 09 85
     39 01 00 00 00 00 02 0e 25
     39 01 00 00 00 00 02 0f 0a
     39 01 00 00 00 00 02 0b 97
     39 01 00 00 00 00 02 0c 97
     39 01 00 00 00 00 02 11 8a
     39 01 00 00 00 00 02 36 7b
     39 01 00 00 00 00 02 71 2c
     39 01 00 00 00 00 02 ff 05
     39 01 00 00 00 00 02 01 00
     39 01 00 00 00 00 02 02 8D
     39 01 00 00 00 00 02 03 8D
     39 01 00 00 00 00 02 04 8D
     39 01 00 00 00 00 02 05 30
     39 01 00 00 00 00 02 06 33
     39 01 00 00 00 00 02 07 77
     39 01 00 00 00 00 02 08 00
     39 01 00 00 00 00 02 09 00
     39 01 00 00 00 00 02 0A 00
     39 01 00 00 00 00 02 0B 80
     39 01 00 00 00 00 02 0C C8
     39 01 00 00 00 00 02 0D 00
     39 01 00 00 00 00 02 0E 1B
     39 01 00 00 00 00 02 0F 07
     39 01 00 00 00 00 02 10 57
     39 01 00 00 00 00 02 11 00
     39 01 00 00 00 00 02 12 00
     39 01 00 00 00 00 02 13 1E
     39 01 00 00 00 00 02 14 00
     39 01 00 00 00 00 02 15 1A
     39 01 00 00 00 00 02 16 05
     39 01 00 00 00 00 02 17 00
     39 01 00 00 00 00 02 18 1E
     39 01 00 00 00 00 02 19 FF
     39 01 00 00 00 00 02 1A 00
     39 01 00 00 00 00 02 1B FC
     39 01 00 00 00 00 02 1C 80
     39 01 00 00 00 00 02 1D 00
     39 01 00 00 00 00 02 1E 10
     39 01 00 00 00 00 02 1F 77
     39 01 00 00 00 00 02 20 00
     39 01 00 00 00 00 02 21 00
     39 01 00 00 00 00 02 22 55
     39 01 00 00 00 00 02 23 0D
     39 01 00 00 00 00 02 31 A0
     39 01 00 00 00 00 02 32 00
     39 01 00 00 00 00 02 33 B8
     39 01 00 00 00 00 02 34 BB
     39 01 00 00 00 00 02 35 11
     39 01 00 00 00 00 02 36 01
     39 01 00 00 00 00 02 37 0B
     39 01 00 00 00 00 02 38 01
     39 01 00 00 00 00 02 39 0B
     39 01 00 00 00 00 02 44 08
     39 01 00 00 00 00 02 45 80
     39 01 00 00 00 00 02 46 CC
     39 01 00 00 00 00 02 47 04
     39 01 00 00 00 00 02 48 00
     39 01 00 00 00 00 02 49 00
     39 01 00 00 00 00 02 4A 01
     39 01 00 00 00 00 02 6C 03
     39 01 00 00 00 00 02 6D 03
     39 01 00 00 00 00 02 6E 2F
     39 01 00 00 00 00 02 43 00
     39 01 00 00 00 00 02 4B 23
     39 01 00 00 00 00 02 4C 01
     39 01 00 00 00 00 02 50 23
     39 01 00 00 00 00 02 51 01
     39 01 00 00 00 00 02 58 23
     39 01 00 00 00 00 02 59 01
     39 01 00 00 00 00 02 5D 23
     39 01 00 00 00 00 02 5E 01
     39 01 00 00 00 00 02 62 23
     39 01 00 00 00 00 02 63 01
     39 01 00 00 00 00 02 67 23
     39 01 00 00 00 00 02 68 01
     39 01 00 00 00 00 02 89 00
     39 01 00 00 00 00 02 8D 01
     39 01 00 00 00 00 02 8E 64
     39 01 00 00 00 00 02 8F 20
     39 01 00 00 00 00 02 97 8E
     39 01 00 00 00 00 02 82 8C
     39 01 00 00 00 00 02 83 02
     39 01 00 00 00 00 02 BB 0A
     39 01 00 00 00 00 02 BC 0A
     39 01 00 00 00 00 02 24 25
     39 01 00 00 00 00 02 25 55
     39 01 00 00 00 00 02 26 05
     39 01 00 00 00 00 02 27 23
     39 01 00 00 00 00 02 28 01
     39 01 00 00 00 00 02 29 31
     39 01 00 00 00 00 02 2A 5D
     39 01 00 00 00 00 02 2B 01
     39 01 00 00 00 00 02 2F 00
     39 01 00 00 00 00 02 30 10
     39 01 00 00 00 00 02 A7 12
     39 01 00 00 00 00 02 2D 03
     39 01 00 00 00 00 02 FF 01
     39 01 00 00 00 00 02 75 00
     39 01 00 00 00 00 02 76 42
     39 01 00 00 00 00 02 77 00
     39 01 00 00 00 00 02 78 56
     39 01 00 00 00 00 02 79 00
     39 01 00 00 00 00 02 7A 79
     39 01 00 00 00 00 02 7B 00
     39 01 00 00 00 00 02 7C 97
     39 01 00 00 00 00 02 7D 00
     39 01 00 00 00 00 02 7E b1
     39 01 00 00 00 00 02 7F 00
     39 01 00 00 00 00 02 80 c8
     39 01 00 00 00 00 02 81 00
     39 01 00 00 00 00 02 82 db
     39 01 00 00 00 00 02 83 00
     39 01 00 00 00 00 02 84 ec
     39 01 00 00 00 00 02 85 00
     39 01 00 00 00 00 02 86 fb
     39 01 00 00 00 00 02 87 01
     39 01 00 00 00 00 02 88 26
     39 01 00 00 00 00 02 89 01
     39 01 00 00 00 00 02 8A 49
     39 01 00 00 00 00 02 8B 01
     39 01 00 00 00 00 02 8C 86
     39 01 00 00 00 00 02 8D 01
     39 01 00 00 00 00 02 8E b3
     39 01 00 00 00 00 02 8F 01
     39 01 00 00 00 00 02 90 fc
     39 01 00 00 00 00 02 91 02
     39 01 00 00 00 00 02 92 37
     39 01 00 00 00 00 02 93 02
     39 01 00 00 00 00 02 94 39
     39 01 00 00 00 00 02 95 02
     39 01 00 00 00 00 02 96 6f
     39 01 00 00 00 00 02 97 02
     39 01 00 00 00 00 02 98 aa
     39 01 00 00 00 00 02 99 02
     39 01 00 00 00 00 02 9A c9
     39 01 00 00 00 00 02 9B 02
     39 01 00 00 00 00 02 9C fc
     39 01 00 00 00 00 02 9D 03
     39 01 00 00 00 00 02 9E 20
     39 01 00 00 00 00 02 9F 03
     39 01 00 00 00 00 02 A0 52
     39 01 00 00 00 00 02 A2 03
     39 01 00 00 00 00 02 A3 62
     39 01 00 00 00 00 02 A4 03
     39 01 00 00 00 00 02 A5 75
     39 01 00 00 00 00 02 A6 03
     39 01 00 00 00 00 02 A7 8a
     39 01 00 00 00 00 02 A9 03
     39 01 00 00 00 00 02 AA a1
     39 01 00 00 00 00 02 AB 03
     39 01 00 00 00 00 02 AC b5
     39 01 00 00 00 00 02 AD 03
     39 01 00 00 00 00 02 AE c6
     39 01 00 00 00 00 02 AF 03
     39 01 00 00 00 00 02 B0 cf
     39 01 00 00 00 00 02 B1 03
     39 01 00 00 00 00 02 B2 d1
     39 01 00 00 00 00 02 B3 00
     39 01 00 00 00 00 02 B4 42
     39 01 00 00 00 00 02 B5 00
     39 01 00 00 00 00 02 B6 56
     39 01 00 00 00 00 02 B7 00
     39 01 00 00 00 00 02 B8 79
     39 01 00 00 00 00 02 B9 00
     39 01 00 00 00 00 02 BA 97
     39 01 00 00 00 00 02 BB 00
     39 01 00 00 00 00 02 BC B1
     39 01 00 00 00 00 02 BD 00
     39 01 00 00 00 00 02 BE C8
     39 01 00 00 00 00 02 BF 00
     39 01 00 00 00 00 02 C0 DB
     39 01 00 00 00 00 02 C1 00
     39 01 00 00 00 00 02 C2 EC
     39 01 00 00 00 00 02 C3 00
     39 01 00 00 00 00 02 C4 FB
     39 01 00 00 00 00 02 C5 01
     39 01 00 00 00 00 02 C6 26
     39 01 00 00 00 00 02 C7 01
     39 01 00 00 00 00 02 C8 49
     39 01 00 00 00 00 02 C9 01
     39 01 00 00 00 00 02 CA 86
     39 01 00 00 00 00 02 CB 01
     39 01 00 00 00 00 02 CC B3
     39 01 00 00 00 00 02 CD 01
     39 01 00 00 00 00 02 CE FC
     39 01 00 00 00 00 02 CF 02
     39 01 00 00 00 00 02 D0 37
     39 01 00 00 00 00 02 D1 02
     39 01 00 00 00 00 02 D2 39
     39 01 00 00 00 00 02 D3 02
     39 01 00 00 00 00 02 D4 6F
     39 01 00 00 00 00 02 D5 02
     39 01 00 00 00 00 02 D6 AA
     39 01 00 00 00 00 02 D7 02
     39 01 00 00 00 00 02 D8 C9
     39 01 00 00 00 00 02 D9 02
     39 01 00 00 00 00 02 DA FC
     39 01 00 00 00 00 02 DB 03
     39 01 00 00 00 00 02 DC 20
     39 01 00 00 00 00 02 DD 03
     39 01 00 00 00 00 02 DE 52
     39 01 00 00 00 00 02 DF 03
     39 01 00 00 00 00 02 E0 62
     39 01 00 00 00 00 02 E1 03
     39 01 00 00 00 00 02 E2 75
     39 01 00 00 00 00 02 E3 03
     39 01 00 00 00 00 02 E4 8A
     39 01 00 00 00 00 02 E5 03
     39 01 00 00 00 00 02 E6 A1
     39 01 00 00 00 00 02 E7 03
     39 01 00 00 00 00 02 E8 B5
     39 01 00 00 00 00 02 E9 03
     39 01 00 00 00 00 02 EA C6
     39 01 00 00 00 00 02 EB 03
     39 01 00 00 00 00 02 EC CF
     39 01 00 00 00 00 02 ED 03
     39 01 00 00 00 00 02 EE D1
     39 01 00 00 00 00 02 EF 00
     39 01 00 00 00 00 02 F0 42
     39 01 00 00 00 00 02 F1 00
     39 01 00 00 00 00 02 F2 56
     39 01 00 00 00 00 02 F3 00
     39 01 00 00 00 00 02 F4 79
     39 01 00 00 00 00 02 F5 00
     39 01 00 00 00 00 02 F6 97
     39 01 00 00 00 00 02 F7 00
     39 01 00 00 00 00 02 F8 B1
     39 01 00 00 00 00 02 F9 00
     39 01 00 00 00 00 02 FA C8
     39 01 00 00 00 00 02 FF 02
     39 01 00 00 00 00 02 00 00
     39 01 00 00 00 00 02 01 DB
     39 01 00 00 00 00 02 02 00
     39 01 00 00 00 00 02 03 EC
     39 01 00 00 00 00 02 04 00
     39 01 00 00 00 00 02 05 FB
     39 01 00 00 00 00 02 06 01
     39 01 00 00 00 00 02 07 26
     39 01 00 00 00 00 02 08 01
     39 01 00 00 00 00 02 09 49
     39 01 00 00 00 00 02 0A 01
     39 01 00 00 00 00 02 0B 86
     39 01 00 00 00 00 02 0C 01
     39 01 00 00 00 00 02 0D B3
     39 01 00 00 00 00 02 0E 01
     39 01 00 00 00 00 02 0F FC
     39 01 00 00 00 00 02 10 02
     39 01 00 00 00 00 02 11 37
     39 01 00 00 00 00 02 12 02
     39 01 00 00 00 00 02 13 39
     39 01 00 00 00 00 02 14 02
     39 01 00 00 00 00 02 15 6F
     39 01 00 00 00 00 02 16 02
     39 01 00 00 00 00 02 17 AA
     39 01 00 00 00 00 02 18 02
     39 01 00 00 00 00 02 19 C9
     39 01 00 00 00 00 02 1A 02
     39 01 00 00 00 00 02 1B FC
     39 01 00 00 00 00 02 1C 03
     39 01 00 00 00 00 02 1D 20
     39 01 00 00 00 00 02 1E 03
     39 01 00 00 00 00 02 1F 52
     39 01 00 00 00 00 02 20 03
     39 01 00 00 00 00 02 21 62
     39 01 00 00 00 00 02 22 03
     39 01 00 00 00 00 02 23 75
     39 01 00 00 00 00 02 24 03
     39 01 00 00 00 00 02 25 8A
     39 01 00 00 00 00 02 26 03
     39 01 00 00 00 00 02 27 A1
     39 01 00 00 00 00 02 28 03
     39 01 00 00 00 00 02 29 B5
     39 01 00 00 00 00 02 2A 03
     39 01 00 00 00 00 02 2B C6
     39 01 00 00 00 00 02 2D 03
     39 01 00 00 00 00 02 2F CF
     39 01 00 00 00 00 02 30 03
     39 01 00 00 00 00 02 31 D1
     39 01 00 00 00 00 02 32 00
     39 01 00 00 00 00 02 33 42
     39 01 00 00 00 00 02 34 00
     39 01 00 00 00 00 02 35 56
     39 01 00 00 00 00 02 36 00
     39 01 00 00 00 00 02 37 79
     39 01 00 00 00 00 02 38 00
     39 01 00 00 00 00 02 39 97
     39 01 00 00 00 00 02 3A 00
     39 01 00 00 00 00 02 3B B1
     39 01 00 00 00 00 02 3D 00
     39 01 00 00 00 00 02 3F C8
     39 01 00 00 00 00 02 40 00
     39 01 00 00 00 00 02 41 DB
     39 01 00 00 00 00 02 42 00
     39 01 00 00 00 00 02 43 EC
     39 01 00 00 00 00 02 44 00
     39 01 00 00 00 00 02 45 FB
     39 01 00 00 00 00 02 46 01
     39 01 00 00 00 00 02 47 26
     39 01 00 00 00 00 02 48 01
     39 01 00 00 00 00 02 49 49
     39 01 00 00 00 00 02 4A 01
     39 01 00 00 00 00 02 4B 86
     39 01 00 00 00 00 02 4C 01
     39 01 00 00 00 00 02 4D B3
     39 01 00 00 00 00 02 4E 01
     39 01 00 00 00 00 02 4F FC
     39 01 00 00 00 00 02 50 02
     39 01 00 00 00 00 02 51 37
     39 01 00 00 00 00 02 52 02
     39 01 00 00 00 00 02 53 39
     39 01 00 00 00 00 02 54 02
     39 01 00 00 00 00 02 55 6F
     39 01 00 00 00 00 02 56 02
     39 01 00 00 00 00 02 58 AA
     39 01 00 00 00 00 02 59 02
     39 01 00 00 00 00 02 5A C9
     39 01 00 00 00 00 02 5B 02
     39 01 00 00 00 00 02 5C FC
     39 01 00 00 00 00 02 5D 03
     39 01 00 00 00 00 02 5E 20
     39 01 00 00 00 00 02 5F 03
     39 01 00 00 00 00 02 60 52
     39 01 00 00 00 00 02 61 03
     39 01 00 00 00 00 02 62 62
     39 01 00 00 00 00 02 63 03
     39 01 00 00 00 00 02 64 75
     39 01 00 00 00 00 02 65 03
     39 01 00 00 00 00 02 66 8A
     39 01 00 00 00 00 02 67 03
     39 01 00 00 00 00 02 68 A1
     39 01 00 00 00 00 02 69 03
     39 01 00 00 00 00 02 6A B5
     39 01 00 00 00 00 02 6B 03
     39 01 00 00 00 00 02 6C C6
     39 01 00 00 00 00 02 6D 03
     39 01 00 00 00 00 02 6E CF
     39 01 00 00 00 00 02 6F 03
     39 01 00 00 00 00 02 70 D1
     39 01 00 00 00 00 02 71 00
     39 01 00 00 00 00 02 72 42
     39 01 00 00 00 00 02 73 00
     39 01 00 00 00 00 02 74 56
     39 01 00 00 00 00 02 75 00
     39 01 00 00 00 00 02 76 79
     39 01 00 00 00 00 02 77 00
     39 01 00 00 00 00 02 78 97
     39 01 00 00 00 00 02 79 00
     39 01 00 00 00 00 02 7A B1
     39 01 00 00 00 00 02 7B 00
     39 01 00 00 00 00 02 7C C8
     39 01 00 00 00 00 02 7D 00
     39 01 00 00 00 00 02 7E DB
     39 01 00 00 00 00 02 7F 00
     39 01 00 00 00 00 02 80 EC
     39 01 00 00 00 00 02 81 00
     39 01 00 00 00 00 02 82 FB
     39 01 00 00 00 00 02 83 01
     39 01 00 00 00 00 02 84 26
     39 01 00 00 00 00 02 85 01
     39 01 00 00 00 00 02 86 49
     39 01 00 00 00 00 02 87 01
     39 01 00 00 00 00 02 88 86
     39 01 00 00 00 00 02 89 01
     39 01 00 00 00 00 02 8A B3
     39 01 00 00 00 00 02 8B 01
     39 01 00 00 00 00 02 8C FC
     39 01 00 00 00 00 02 8D 02
     39 01 00 00 00 00 02 8E 37
     39 01 00 00 00 00 02 8F 02
     39 01 00 00 00 00 02 90 39
     39 01 00 00 00 00 02 91 02
     39 01 00 00 00 00 02 92 6F
     39 01 00 00 00 00 02 93 02
     39 01 00 00 00 00 02 94 AA
     39 01 00 00 00 00 02 95 02
     39 01 00 00 00 00 02 96 C9
     39 01 00 00 00 00 02 97 02
     39 01 00 00 00 00 02 98 FC
     39 01 00 00 00 00 02 99 03
     39 01 00 00 00 00 02 9A 20
     39 01 00 00 00 00 02 9B 03
     39 01 00 00 00 00 02 9C 52
     39 01 00 00 00 00 02 9D 03
     39 01 00 00 00 00 02 9E 62
     39 01 00 00 00 00 02 9F 03
     39 01 00 00 00 00 02 A0 75
     39 01 00 00 00 00 02 A2 03
     39 01 00 00 00 00 02 A3 8A
     39 01 00 00 00 00 02 A4 03
     39 01 00 00 00 00 02 A5 A1
     39 01 00 00 00 00 02 A6 03
     39 01 00 00 00 00 02 A7 B5
     39 01 00 00 00 00 02 A9 03
     39 01 00 00 00 00 02 AA C6
     39 01 00 00 00 00 02 AB 03
     39 01 00 00 00 00 02 AC CF
     39 01 00 00 00 00 02 AD 03
     39 01 00 00 00 00 02 AE D1
     39 01 00 00 00 00 02 AF 00
     39 01 00 00 00 00 02 B0 42
     39 01 00 00 00 00 02 B1 00
     39 01 00 00 00 00 02 B2 56
     39 01 00 00 00 00 02 B3 00
     39 01 00 00 00 00 02 B4 79
     39 01 00 00 00 00 02 B5 00
     39 01 00 00 00 00 02 B6 97
     39 01 00 00 00 00 02 B7 00
     39 01 00 00 00 00 02 B8 B1
     39 01 00 00 00 00 02 B9 00
     39 01 00 00 00 00 02 BA C8
     39 01 00 00 00 00 02 BB 00
     39 01 00 00 00 00 02 BC DB
     39 01 00 00 00 00 02 BD 00
     39 01 00 00 00 00 02 BE EC
     39 01 00 00 00 00 02 BF 00
     39 01 00 00 00 00 02 C0 FB
     39 01 00 00 00 00 02 C1 01
     39 01 00 00 00 00 02 C2 26
     39 01 00 00 00 00 02 C3 01
     39 01 00 00 00 00 02 C4 49
     39 01 00 00 00 00 02 C5 01
     39 01 00 00 00 00 02 C6 86
     39 01 00 00 00 00 02 C7 01
     39 01 00 00 00 00 02 C8 B3
     39 01 00 00 00 00 02 C9 01
     39 01 00 00 00 00 02 CA FC
     39 01 00 00 00 00 02 CB 02
     39 01 00 00 00 00 02 CC 37
     39 01 00 00 00 00 02 CD 02
     39 01 00 00 00 00 02 CE 39
     39 01 00 00 00 00 02 CF 02
     39 01 00 00 00 00 02 D0 6F
     39 01 00 00 00 00 02 D1 02
     39 01 00 00 00 00 02 D2 AA
     39 01 00 00 00 00 02 D3 02
     39 01 00 00 00 00 02 D4 C9
     39 01 00 00 00 00 02 D5 02
     39 01 00 00 00 00 02 D6 FC
     39 01 00 00 00 00 02 D7 03
     39 01 00 00 00 00 02 D8 20
     39 01 00 00 00 00 02 D9 03
     39 01 00 00 00 00 02 DA 52
     39 01 00 00 00 00 02 DB 03
     39 01 00 00 00 00 02 DC 62
     39 01 00 00 00 00 02 DD 03
     39 01 00 00 00 00 02 DE 75
     39 01 00 00 00 00 02 DF 03
     39 01 00 00 00 00 02 E0 8A
     39 01 00 00 00 00 02 E1 03
     39 01 00 00 00 00 02 E2 A1
     39 01 00 00 00 00 02 E3 03
     39 01 00 00 00 00 02 E4 B5
     39 01 00 00 00 00 02 E5 03
     39 01 00 00 00 00 02 E6 C6
     39 01 00 00 00 00 02 E7 03
     39 01 00 00 00 00 02 E8 CF
     39 01 00 00 00 00 02 E9 03
     39 01 00 00 00 00 02 EA D1
     39 01 00 00 00 00 02 FF 03
     39 01 00 00 00 00 02 FB 01
     39 01 00 00 00 00 02 00 00
     39 01 00 00 00 00 02 01 06
     39 01 00 00 00 00 02 02 0c
     39 01 00 00 00 00 02 03 12
     39 01 00 00 00 00 02 04 18
     39 01 00 00 00 00 02 05 1e
     39 01 00 00 00 00 02 06 24
     39 01 00 00 00 00 02 07 24
     39 01 00 00 00 00 02 08 1e
     39 01 00 00 00 00 02 09 18
     39 01 00 00 00 00 02 0A 0c
     39 01 00 00 00 00 02 0B 00
     39 01 00 00 00 00 02 0C 00
     39 01 00 00 00 00 02 0D 00
     39 01 00 00 00 00 02 0E 00
     39 01 00 00 00 00 02 0F 00
     39 01 00 00 00 00 02 1B 25
     39 01 00 00 00 00 02 1C 2a
     39 01 00 00 00 00 02 1D 28
     39 01 00 00 00 00 02 1E 26
     39 01 00 00 00 00 02 1F 24
     39 01 00 00 00 00 02 20 22
     39 01 00 00 00 00 02 24 00
     39 01 00 00 00 00 02 25 40
     39 01 00 00 00 00 02 18 00
     39 01 00 00 00 00 02 19 00
     39 01 00 00 00 00 02 1A 00
     39 01 00 00 00 00 02 21 00
     39 01 00 00 00 00 02 22 00
     39 01 00 00 00 00 02 23 00
     39 01 00 00 00 00 02 FF 00
     39 01 00 00 00 00 02 FB 01
     39 01 00 00 00 00 02 FF 01
     39 01 00 00 00 00 02 FB 01
     39 01 00 00 00 00 02 FF 02
     39 01 00 00 00 00 02 FB 01
     39 01 00 00 00 00 02 FF 03
     39 01 00 00 00 00 02 FB 01
     39 01 00 00 00 00 02 FF 04
     39 01 00 00 00 00 02 FB 01
     39 01 00 00 00 00 02 FF 05
     39 01 00 00 00 00 02 FB 01
     39 01 00 00 00 00 02 FF 00
     39 01 00 00 00 00 02 51 00
     39 01 00 00 00 00 02 53 2C
     39 01 00 00 00 00 02 55 00
     39 01 00 00 00 00 02 FF 00
     39 01 00 00 00 00 02 35 00                                                
     05 01 00 00 96 00 02 11 00 
     05 01 00 00 32 00 02 29 00
	 05 01 00 00 00 00 02 51 A0
	 05 01 00 00 00 00 02 53 2c
	 05 01 00 00 00 00 02 55 01];
		qcom,mdss-dsi-on-command-state = "dsi_lp_mode";
		qcom,mdss-dsi-off-command = [05 01 00 00 32 00 02 28 00
					                 05 01 00 00 78 00 02 10 00];
                qcom,mdss-dsi-off-command-state = "dsi_hs_mode";
        };
};