/* Copyright (c) 2013, The Linux Foundation. All rights reserved.
 *
 * This program is free software; you can redistribute it and/or modify
 * it under the terms of the GNU General Public License version 2 and
 * only version 2 as published by the Free Software Foundation.
 *
 * This program is distributed in the hope that it will be useful,
 * but WITHOUT ANY WARRANTY; without even the implied warranty of
 * MERCHANTABILITY or FITNESS FOR A PARTICULAR PURPOSE.  See the
 * GNU General Public License for more details.
 */

/*---------------------------------------------------------------------------
 * This file is autogenerated file using gcdb parser. Please do not edit it.
 * Update input XML file to add a new entry or update variable in this file
 * VERSION = "1.0"
 *---------------------------------------------------------------------------*/
&mdss_mdp {
	dsi_cpt_wvga_vid: qcom,mdss_dsi_fl108802_cpt_wvga_video {
		qcom,mdss-dsi-panel-name = "zteCPT(FL108802)_480*800_4Inch_801";
		qcom,mdss-pan-physical-height-dimension = <86>;		
		qcom,mdss-pan-physical-width-dimension = <52>;
		qcom,cont-splash-enabled;
		qcom,mdss-dsi-panel-controller = <&mdss_dsi0>;
		qcom,mdss-dsi-panel-type = "dsi_video_mode";
		qcom,mdss-dsi-panel-destination = "display_1";
		qcom,mdss-dsi-panel-framerate = <60>;
		qcom,mdss-dsi-virtual-channel-id = <0>;
		qcom,mdss-dsi-stream = <0>;
		qcom,mdss-dsi-panel-width = <480>;
		qcom,mdss-dsi-panel-height = <800>;
		qcom,mdss-dsi-h-front-porch = <160>;
		qcom,mdss-dsi-h-back-porch = <40>;
		qcom,mdss-dsi-h-pulse-width = <10>;
		qcom,mdss-dsi-h-sync-skew = <0>;
		qcom,mdss-dsi-v-back-porch = <10>;
		qcom,mdss-dsi-v-front-porch = <12>;
		qcom,mdss-dsi-v-pulse-width = <2>;
		qcom,mdss-dsi-h-left-border = <0>;
		qcom,mdss-dsi-h-right-border = <0>;
		qcom,mdss-dsi-v-top-border = <0>;
		qcom,mdss-dsi-v-bottom-border = <0>;
		qcom,mdss-dsi-bpp = <24>;
		qcom,mdss-dsi-color-order = "rgb_swap_rgb";
		qcom,mdss-dsi-underflow-color = <0xff>;
		qcom,mdss-dsi-border-color = <0>;
		qcom,mdss-dsi-reset-sequence = <1 20>, <0 10>, <1 20>;
		qcom,mdss-dsi-on-command = [
39 01 00 00 00 00 04 B9 F1 08 01
39 01 00 00 00 00 05 B1 22 1E 1E 87 
39 01 00 00 00 00 02 B2 23 
39 01 00 00 00 00 09 B3 01 00 06 0C 12 13 43 40 
39 01 00 00 00 00 12 BA 31 00 44 25 91 0A 00 00 E1 00 00 00 0F 02 4F B9 EE 
39 01 00 00 00 00 06 E3 05 05 01 01 00 
39 01 00 00 00 00 03 B5 07 07 
39 01 00 00 00 00 03 B6 92 92 
39 01 00 00 00 00 03 B8 64 28 
39 01 00 00 00 00 02 B4 00 
39 01 00 00 00 00 02 CC 00 
39 01 00 00 00 00 02 BC 47
39 01 00 00 00 00 34 E9 00 00 05 00 00 0A 80 12 30 00 33 09 0A 80 37 00 03 00 00 00 00 08 00 00 20 64 02
                00 00 00 00 00 00 31 75 13 00 00 00 00 00 00 00 00 00 00 00 00 00 00 00 
39 01 00 00 00 00 17 EA 94 00 00 00 08 95 10 07 35 10 00 00 00 08 94 00 06 24 00 00 00 00 
39 01 00 00 00 00 23 E0 00 00 00 0D 0E 2A 19 32 00 07 13 18 19 18 17 12 19 00 00 00 0D 0E 2A
                19 32 00 07 13 18 19 18 17 12 19 
05 01 00 00 78 00 02 11 00
05 01 00 00 0a 00 02 29 00
					];
					
	qcom,mdss-dsi-off-command = [05 01 00 00 32 00 02 28 00
					05 01 00 00 78 00 02 10 00
					23 01 00 00 10 00 02
						b0 04
					23 01 00 00 20 00 02
						b1 01];
		qcom,mdss-dsi-on-command-state = "dsi_lp_mode";
		qcom,mdss-dsi-off-command-state = "dsi_hs_mode";
		qcom,mdss-dsi-h-sync-pulse = <1>;
		qcom,mdss-dsi-traffic-mode = "non_burst_sync_event";
		qcom,mdss-dsi-lane-map = "lane_map_3012";
		qcom,mdss-dsi-bllp-eof-power-mode;
		qcom,mdss-dsi-bllp-power-mode;
		qcom,mdss-dsi-lane-0-state;
		qcom,mdss-dsi-lane-1-state;
		qcom,mdss-dsi-panel-timings = [6B 1A 10 00 3C 42 14 1C 15 03 04 00];
		qcom,mdss-dsi-t-clk-post = <0x04>;
		qcom,mdss-dsi-t-clk-pre = <0x18>;
		qcom,mdss-dsi-bl-min-level = <1>;
		qcom,mdss-dsi-bl-max-level = <4095>;
		qcom,mdss-dsi-dma-trigger = <0x04>;
		qcom,mdss-dsi-mdp-trigger = <0x0>;
		qcom,mdss-dsi-bl-pmic-control-type = "bl_ctrl_wled";
	};
};
