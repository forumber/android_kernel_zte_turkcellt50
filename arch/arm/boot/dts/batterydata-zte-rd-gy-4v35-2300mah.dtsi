/* Copyright (c) 2013, The Linux Foundation. All rights reserved.
 *
 * This program is free software; you can redistribute it and/or modify
 * it under the terms of the GNU General Public License version 2 and
 * only version 2 as published by the Free Software Foundation.
 *
 * This program is distributed in the hope that it will be useful,
 * but WITHOUT ANY WARRANTY; without even the implied warranty of
 * MERCHANTABILITY or FITNESS FOR A PARTICULAR PURPOSE.  See the
 * GNU General Public License for more details.
 */

qcom,zte-rd-gy-4v35-2300mAh-data {
	qcom,fcc-mah = <2300>;
	qcom,default-rbatt-mohm = <181>;
	qcom,rbatt-capacitive-mohm = <0>;
	qcom,flat-ocv-threshold-uv = <3800000>;
	qcom,max-voltage-uv = <4350000>;
	qcom,v-cutoff-uv = <3420000>;
	qcom,chg-term-ua = <100000>;
	qcom,batt-id-kohm = <150>;

	qcom,rbatt-sf-lut {
		qcom,lut-col-legend = <(-20) 0 25 40 60>;
		qcom,lut-row-legend = <100 95 90 85 80>,
				<75 70 65 60 55>,
				<50 45 40 35 30>,
				<25 20 16 13 11>,
				<10 9 8 7 6>,
				<5 4 3 2 1>,
				<0>;
		qcom,lut-data = <1073 240 100 85 84>,
				<1073 240 100 85 84>,
				<1011 246 102 87 84>,
				<976 250 105 88 85>,
				<951 244 109 91 87>,
				<876 254 116 95 90>,
				<871 226 119 98 92>,
				<859 230 121 102 96>,
				<864 233 107 98 95>,
				<883 233 101 89 88>,
				<909 234 102 88 88>,
				<942 237 105 91 90>,
				<977 239 107 93 92>,
				<1018 246 108 95 94>,
				<1067 258 108 94 92>,
				<1128 272 108 91 90>,
				<1201 285 108 92 92>,
				<1265 305 109 94 93>,
				<1300 326 109 92 92>,
				<1306 325 111 94 93>,
				<1356 339 112 95 94>,
				<1449 357 116 98 96>,
				<1607 377 121 101 98>,
				<1838 404 125 103 101>,
				<2173 435 126 104 101>,
				<2640 478 127 104 101>,
				<3373 553 132 106 102>,
				<4594 679 143 110 105>,
				<6946 948 166 119 114>,
				<13809 1660 326 154 139>,
				<65139 33843 21831 12361 9062>;
	};

	qcom,fcc-temp-lut {
		qcom,lut-col-legend = <(-20) 0 25 40 60>;
		qcom,lut-data = <2358 2353 2364 2363 2357>;
	};

	qcom,pc-temp-ocv-lut {
		qcom,lut-col-legend = <(-20) 0 25 40 60>;
		qcom,lut-row-legend = <100 95 90 85 80>,
				<75 70 65 60 55>,
				<50 45 40 35 30>,
				<25 20 16 13 11>,
				<10 9 8 7 6>,
				<5 4 3 2 1>,
				<0>;
		qcom,lut-data = <4324 4322 4315 4315 4302>,
				<4219 4250 4251 4250 4240>,
				<4147 4193 4194 4193 4184>,
				<4093 4138 4140 4139 4130>,
				<4040 4082 4088 4087 4078>,
				<3952 4032 4043 4040 4030>,
				<3906 3957 3985 3990 3986>,
				<3861 3918 3944 3950 3945>,
				<3827 3887 3897 3903 3900>,
				<3803 3855 3861 3862 3858>,
				<3786 3827 3834 3834 3830>,
				<3772 3803 3812 3812 3808>,
				<3760 3784 3794 3794 3790>,
				<3747 3770 3778 3778 3774>,
				<3734 3759 3764 3760 3752>,
				<3720 3745 3748 3740 3726>,
				<3701 3726 3728 3719 3705>,
				<3682 3709 3706 3697 3683>,
				<3662 3698 3688 3680 3666>,
				<3647 3690 3683 3675 3662>,
				<3636 3686 3680 3673 3660>,
				<3623 3682 3677 3671 3657>,
				<3608 3675 3673 3666 3651>,
				<3590 3664 3664 3656 3641>,
				<3568 3646 3643 3634 3616>,
				<3539 3616 3606 3596 3578>,
				<3501 3574 3557 3548 3530>,
				<3450 3517 3495 3486 3468>,
				<3373 3436 3411 3403 3388>,
				<3247 3310 3282 3275 3266>,
				<3000 3000 3000 3000 3000>;
	};
};
