/* Copyright (c) 2013, The Linux Foundation. All rights reserved.
 *
 * This program is free software; you can redistribute it and/or modify
 * it under the terms of the GNU General Public License version 2 and
 * only version 2 as published by the Free Software Foundation.
 *
 * This program is distributed in the hope that it will be useful,
 * but WITHOUT ANY WARRANTY; without even the implied warranty of
 * MERCHANTABILITY or FITNESS FOR A PARTICULAR PURPOSE.  See the
 * GNU General Public License for more details.
 */

qcom,zte-4v2-4000mah-data {
	qcom,fcc-mah = <4000>;
	qcom,default-rbatt-mohm = <118>;
	qcom,rbatt-capacitive-mohm = <0>;
	qcom,flat-ocv-threshold-uv = <3800000>;
	qcom,max-voltage-uv = <4200000>;
	qcom,v-cutoff-uv = <3400000>;
	qcom,chg-term-ua = <100000>;
	qcom,batt-id-kohm = <130>;

	qcom,rbatt-sf-lut {
		qcom,lut-col-legend = <(-20) 0 25 40 60>;
		qcom,lut-row-legend = <100 95 90 85 80>,
				<75 70 65 60 55>,
				<50 45 40 35 30>,
				<25 20 15 10 9>,
				<8 7 6 5 4>,
				<3 2 1 0>;
		qcom,lut-data = <1414 301 100 74 67>,
				<1414 303 100 74 67>,
				<1285 356 103 78 67>,
				<1269 306 109 79 69>,
				<1246 302 113 84 71>,
				<1246 306 121 88 72>,
				<1275 301 123 92 75>,
				<1324 297 115 96 78>,
				<1395 292 101 85 74>,
				<1466 286 97 76 67>,
				<1534 285 98 77 67>,
				<1596 297 100 78 68>,
				<1660 326 100 81 71>,
				<1728 377 100 81 72>,
				<1800 440 101 80 70>,
				<1899 517 105 78 67>,
				<2232 617 110 78 68>,
				<2784 758 110 78 68>,
				<3459 728 113 79 69>,
				<3312 762 119 81 70>,
				<3698 799 126 84 71>,
				<4161 846 133 86 72>,
				<4734 896 134 85 69>,
				<5482 953 127 79 69>,
				<6525 1018 134 81 70>,
				<8234 1095 146 82 71>,
				<11831 1175 173 86 75>,
				<29109 1417 11564 139 92>,
				<92139 30669 64385 6000 10042>;
	};

	qcom,fcc-temp-lut {
		qcom,lut-col-legend = <(-20) 0 25 40 60>;
		qcom,lut-data = <4017 4097 4170 4043 4037>;
	};

	qcom,pc-temp-ocv-lut {
		qcom,lut-col-legend = <(-20) 0 25 40 60>;
		qcom,lut-row-legend = <100 95 90 85 80>,
				<75 70 65 60 55>,
				<50 45 40 35 30>,
				<25 20 15 10 9>,
				<8 7 6 5 4>,
				<3 2 1 0>;
		qcom,lut-data = <4175 4173 4179 4162 4154>,
				<4072 4096 4117 4104 4103>,
				<3946 4051 4072 4063 4060>,
				<3899 3979 4027 4017 4020>,
				<3853 3939 3982 3982 3983>,
				<3822 3906 3953 3952 3950>,
				<3806 3874 3920 3921 3920>,
				<3793 3844 3884 3890 3891>,
				<3781 3818 3850 3854 3855>,
				<3767 3795 3825 3826 3825>,
				<3754 3779 3806 3807 3806>,
				<3739 3768 3791 3793 3792>,
				<3724 3757 3777 3780 3780>,
				<3708 3745 3767 3769 3768>,
				<3689 3733 3757 3758 3752>,
				<3668 3721 3746 3744 3733>,
				<3643 3709 3728 3727 3715>,
				<3611 3695 3701 3702 3690>,
				<3568 3675 3683 3682 3671>,
				<3559 3667 3681 3680 3670>,
				<3546 3658 3677 3679 3667>,
				<3530 3646 3670 3675 3663>,
				<3511 3631 3652 3664 3646>,
				<3488 3610 3614 3631 3611>,
				<3457 3579 3560 3584 3563>,
				<3414 3534 3489 3522 3500>,
				<3347 3466 3385 3439 3416>,
				<3211 3352 3225 3306 3286>,
				<3000 3000 3000 3000 3000>;
	};
};
