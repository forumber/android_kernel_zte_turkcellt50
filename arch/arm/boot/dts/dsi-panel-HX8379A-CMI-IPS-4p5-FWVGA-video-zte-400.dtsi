/* Copyright (c) 2012, Code Aurora Forum. All rights reserved.
 *
 * This program is free software; you can redistribute it and/or modify
 * it under the terms of the GNU General Public License version 2 and
 * only version 2 as published by the Free Software Foundation.
 *
 * This program is distributed in the hope that it will be useful,
 * but WITHOUT ANY WARRANTY; without even the implied warranty of
 * MERCHANTABILITY or FITNESS FOR A PARTICULAR PURPOSE.  See the
 * GNU General Public License for more details.
 */

/*---------------------------------------------------------------------------
 * This file is autogenerated file using gcdb parser. Please do not edit it.
 * Update input XML file to add a new entry or update variable in this file
 * VERSION = "1.0"
 *---------------------------------------------------------------------------*/
&mdss_mdp {

		dsi_hx8379a_CMI_fwvga_vid: qcom,mdss_dsi_hx8379a_CMI_4p5_fwvga_video_400 {
		
		qcom,mdss-dsi-panel-name = "hx8379a CMI 4p5 fwvga video mode dsi panel-kernel";		
		zte,lcd-proc-panel-name = "zteLEAD(hx8379a+CMI)_480*854_4.5Inch";		
		qcom,cont-splash-enabled;	
		zte,lcd-product = <400>;		
		qcom,mdss-dsi-panel-controller = <&mdss_dsi0>;
		qcom,mdss-dsi-panel-type = "dsi_video_mode";
		qcom,mdss-dsi-panel-destination = "display_1";
		qcom,mdss-dsi-panel-framerate = <60>;
		qcom,mdss-dsi-virtual-channel-id = <0>;
		qcom,mdss-dsi-stream = <0>;
		qcom,mdss-dsi-panel-width = <480>;
		qcom,mdss-dsi-panel-height = <854>;
		qcom,mdss-dsi-h-front-porch = <100>;
		qcom,mdss-dsi-h-back-porch = <100>;
		qcom,mdss-dsi-h-pulse-width = <40>;
		qcom,mdss-dsi-h-sync-skew = <0>;
		qcom,mdss-dsi-v-back-porch = <6>;
		qcom,mdss-dsi-v-front-porch = <6>;
		qcom,mdss-dsi-v-pulse-width = <6>;
		qcom,mdss-dsi-h-left-border = <0>;
		qcom,mdss-dsi-h-right-border = <0>;
		qcom,mdss-dsi-v-top-border = <0>;
		qcom,mdss-dsi-v-bottom-border = <0>;
		qcom,mdss-dsi-bpp = <24>;
		qcom,mdss-dsi-color-order = "rgb_swap_rgb";
		qcom,mdss-dsi-underflow-color = <0xff>;
		qcom,mdss-dsi-border-color = <0>;		
		
		qcom,mdss-dsi-h-sync-pulse = <1>;
		qcom,mdss-dsi-traffic-mode = "non_burst_sync_pulse";
		qcom,mdss-dsi-lane-map = "lane_map_3012";
		qcom,mdss-dsi-bllp-eof-power-mode;
		qcom,mdss-dsi-bllp-power-mode;
		qcom,mdss-dsi-lane-0-state;
		qcom,mdss-dsi-lane-1-state;
		qcom,mdss-dsi-panel-timings = [30 1c 12 00 40 44 16 1e 0e 03 04 00];
		qcom,mdss-dsi-t-clk-post = <0x22>;
		qcom,mdss-dsi-t-clk-pre = <0x3d>;
		qcom,mdss-dsi-bl-min-level = <1>;
		qcom,mdss-dsi-bl-max-level = <4095>;		
		qcom,mdss-dsi-dma-trigger = <0x04>;
		qcom,mdss-dsi-mdp-trigger = <0x0>;
		qcom,mdss-dsi-bl-pmic-control-type = "bl_ctrl_wled";
		qcom,mdss-dsi-bl-cmd-gpio = <&msmgpio 34 0>;
		qcom,mdss-dsi-on-command = [
			 39 01 00 00 00 00 04 
                                B9 FF 83 79 
                        39 01 00 00 00 00 03
                                BA 51 93
                        39 01 00 00 00 00 14 
                                B1 00 50 24 
                                EA 90 08 11 
                                11 71 2B 33 
                                9D 1D 12 08 
                                6E F1 00 E6 
                        39 01 00 00 00 00 0E 
                                B2 00 00 FE 
                                08 0C 19 22 
                                00 FF 08 0C 
                                19 20 
                        39 01 00 00 00 00 20 
                                B4 80 0A 00 
                                32 10 05 32 
                                13 69 32 10 
                                08 37 02 20 
                                07 37 00 3A 
                                0C 3E 3E 0C 
                                00 40 08 28 
                                08 30 30 04 
                       39 01 00 00 10 00 30 
                                D5 00 00 0A 
                                00 01 05 00 
                                0A 00 88 88 
                                89 88 23 01 
                                67 45 88 01 
                                88 45 88 88 
                                88 88 88 88 
                                88 88 54 76 
                                10 32 88 54 
                                88 10 88 88 
                                88 88 00 00 
                                00 00 00 00 
                        39 01 00 00 00 00 24 
                                E0 79 07 12 
                                14 3B 3A 3F 
                                23 4A 06 0C 
                                0D 10 11 10 
                                12 14 1F 07 
                                12 14 3B 3A 
                                3F 23 4A 06 
                                0C 0D 10 11 
                                10 12 14 1F 
                        39 01 00 00 00 00 02 
                                CC 02 
                        39 01 00 00 00 00 05 
                                B6 00 b8 00 b8 
                        05 01 00 00 96 00 02 
                                11 00 
                        05 01 00 00 78 00 02 
                                29 00 
				];
		qcom,mdss-dsi-on-command-state = "dsi_lp_mode";
		qcom,mdss-dsi-off-command = [05 01 00 00 32 00 02 28 00
					05 01 00 00 78 00 02 10 00];
		qcom,mdss-dsi-off-command-state = "dsi_hs_mode";
	};
};
