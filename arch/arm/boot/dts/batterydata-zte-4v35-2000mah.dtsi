/* Copyright (c) 2013, The Linux Foundation. All rights reserved.
 *
 * This program is free software; you can redistribute it and/or modify
 * it under the terms of the GNU General Public License version 2 and
 * only version 2 as published by the Free Software Foundation.
 *
 * This program is distributed in the hope that it will be useful,
 * but WITHOUT ANY WARRANTY; without even the implied warranty of
 * MERCHANTABILITY or FITNESS FOR A PARTICULAR PURPOSE.  See the
 * GNU General Public License for more details.
 */

qcom,zte-4v35-2000mAh-data {
	qcom,fcc-mah = <2000>;
	qcom,default-rbatt-mohm = <160>;
	qcom,rbatt-capacitive-mohm = <0>;
	qcom,flat-ocv-threshold-uv = <3800000>;
	qcom,max-voltage-uv = <4350000>;
	qcom,v-cutoff-uv = <3400000>;
	qcom,chg-term-ua = <100000>;
	qcom,batt-id-kohm = <200>;

	qcom,rbatt-sf-lut {
		qcom,lut-col-legend = <(-20) 0 25 40 60>;
		qcom,lut-row-legend = <100 95 90 85 80>,
				<75 70 65 60 55>,
				<50 45 40 35 30>,
				<25 20 16 13 11>,
				<10 9 8 7 6>,
				<5 4 3 2 1>,
				<0>;
		qcom,lut-data = <1015 228 100 83 76>,
				<1013 228 100 83 76>,
				<946 238 102 85 76>,
				<889 246 106 86 78>,
				<898 246 110 90 80>,
				<801 258 118 93 82>,
				<805 223 121 97 85>,
				<810 226 126 101 87>,
				<812 225 115 100 88>,
				<822 223 103 89 81>,
				<855 225 100 85 79>,
				<905 227 102 86 80>,
				<974 230 103 90 81>,
				<1055 235 105 91 84>,
				<1146 244 106 89 83>,
				<1248 249 106 86 78>,
				<1362 256 106 86 78>,
				<1515 286 109 88 79>,
				<1606 282 99 85 78>,
				<1430 301 102 86 79>,
				<1586 319 105 88 80>,
				<1751 335 108 90 81>,
				<1934 356 111 92 83>,
				<2203 371 116 93 83>,
				<2506 400 115 91 80>,
				<2979 444 113 91 82>,
				<3668 515 118 93 83>,
				<4833 627 125 98 87>,
				<8571 899 143 106 95>,
				<28443 7453 268 144 154>,
				<69968 14480 1555 6292 971>;
	};

	qcom,fcc-temp-lut {
		qcom,lut-col-legend = <(-20) 0 25 40 60>;
		qcom,lut-data = <2043 2068 2066 2059 2043>;
	};

	qcom,pc-temp-ocv-lut {
		qcom,lut-col-legend = <(-20) 0 25 40 60>;
		qcom,lut-row-legend = <100 95 90 85 80>,
				<75 70 65 60 55>,
				<50 45 40 35 30>,
				<25 20 16 13 11>,
				<10 9 8 7 6>,
				<5 4 3 2 1>,
				<0>;
		qcom,lut-data = <4320 4319 4322 4317 4309>,
				<4225 4245 4251 4249 4243>,
				<4156 4188 4193 4190 4186>,
				<4090 4135 4138 4135 4131>,
				<4050 4083 4086 4083 4079>,
				<3949 4026 4041 4036 4030>,
				<3908 3948 3980 3985 3986>,
				<3872 3914 3946 3948 3945>,
				<3836 3882 3901 3905 3904>,
				<3805 3851 3861 3863 3862>,
				<3785 3825 3832 3833 3833>,
				<3771 3803 3810 3810 3810>,
				<3760 3784 3793 3793 3791>,
				<3749 3771 3779 3778 3775>,
				<3738 3760 3767 3763 3756>,
				<3724 3743 3754 3746 3732>,
				<3706 3722 3734 3725 3710>,
				<3686 3709 3712 3703 3688>,
				<3665 3702 3691 3682 3670>,
				<3647 3695 3688 3679 3667>,
				<3635 3692 3686 3678 3666>,
				<3621 3687 3685 3677 3665>,
				<3602 3678 3682 3674 3662>,
				<3582 3661 3678 3669 3655>,
				<3555 3635 3662 3650 3632>,
				<3521 3598 3625 3614 3593>,
				<3475 3548 3575 3564 3543>,
				<3412 3480 3510 3500 3478>,
				<3317 3383 3421 3413 3389>,
				<3185 3246 3286 3284 3254>,
				<3000 3000 3000 3000 3000>;
	};
};
