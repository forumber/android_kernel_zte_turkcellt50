## Kconfig
```kconfig
#
# For a description of the syntax of this configuration file,
# see Documentation/kbuild/kconfig-language.txt.
#
mainmenu "Linux/$ARCH $KERNELVERSION Kernel Configuration"

config SRCARCH
	string
	option env="SRCARCH"

config TARGET_BUILD_VARIANT
        string
        option env="TARGET_BUILD_VARIANT"

source "arch/$SRCARCH/Kconfig"

source "arch/$SRCARCH/$TARGET_BUILD_VARIANT/Kconfig
```
